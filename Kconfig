## Kconfig
```kconfig
#
# Copyright (C) 2011 Alex Smith
#
# Permission to use, copy, modify, and/or distribute this software for any
# purpose with or without fee is hereby granted, provided that the above
# copyright notice and this permission notice appear in all copies.
#
# THE SOFTWARE IS PROVIDED "AS IS" AND THE AUTHOR DISCLAIMS ALL WARRANTIES
# WITH REGARD TO THIS SOFTWARE INCLUDING ALL IMPLIED WARRANTIES OF
# MERCHANTABILITY AND FITNESS. IN NO EVENT SHALL THE AUTHOR BE LIABLE FOR
# ANY SPECIAL, DIRECT, INDIRECT, OR CONSEQUENTIAL DAMAGES OR ANY DAMAGES
# WHATSOEVER RESULTING FROM LOSS OF USE, DATA OR PROFITS, WHETHER IN AN
# ACTION OF CONTRACT, NEGLIGENCE OR OTHER TORTIOUS ACTION, ARISING OUT OF
# OR IN CONNECTION WITH THE USE OR PERFORMANCE OF THIS SOFTWARE.
#

mainmenu "KBoot Configuration"

####################
menu "Build options"
####################

config CROSS_COMPILER
	string "Cross-compiler prefix"
	default ""
	help
	  Prefix for cross-compiler utilities, e.g. /usr/cross/bin/i686-elf-
	  If empty, the system's default compiler will be used.

config EXTRA_CCFLAGS
	string "Extra CCFLAGS"
	default ""
	help
	  Extra options for the C compiler.

#######
endmenu
#######

comment "Target system"

source "config/Kconfig.arch"
source "config/Kconfig.platform"

comment "Feature configuration"

config DEBUG
	bool "Debug build"
	default y
	help
	  Enable various sections of debugging code and extra checks. This will
	  increase the size of the final loader binaries, so don't enable it
	  unless necessary.

source "source/Kconfig"
```

## config/Kconfig.arch
```kconfig
#
# Copyright (C) 2011-2013 Alex Smith
#
# Permission to use, copy, modify, and/or distribute this software for any
# purpose with or without fee is hereby granted, provided that the above
# copyright notice and this permission notice appear in all copies.
#
# THE SOFTWARE IS PROVIDED "AS IS" AND THE AUTHOR DISCLAIMS ALL WARRANTIES
# WITH REGARD TO THIS SOFTWARE INCLUDING ALL IMPLIED WARRANTIES OF
# MERCHANTABILITY AND FITNESS. IN NO EVENT SHALL THE AUTHOR BE LIABLE FOR
# ANY SPECIAL, DIRECT, INDIRECT, OR CONSEQUENTIAL DAMAGES OR ANY DAMAGES
# WHATSOEVER RESULTING FROM LOSS OF USE, DATA OR PROFITS, WHETHER IN AN
# ACTION OF CONTRACT, NEGLIGENCE OR OTHER TORTIOUS ACTION, ARISING OUT OF
# OR IN CONNECTION WITH THE USE OR PERFORMANCE OF THIS SOFTWARE.
#

config LITTLE_ENDIAN
        bool

config BIG_ENDIAN
        bool

choice
	prompt "Architecture"
	default ARCH_X86

config ARCH_ARM
	bool "ARM"
	select LITTLE_ENDIAN
	help
	  Target the built system to ARM processors.

config ARCH_MIPS
	bool "MIPS"
	help
	  Target the built system to MIPS processors. Endianness is determined
	  by the platform type selected.

config ARCH_X86
	bool "x86"
	select LITTLE_ENDIAN
	help
	  Target the built system to x86 CPUs (will support both 32- and 64-bit
	  kernels).

endchoice

config ARCH
        string
        default "arm" if ARCH_ARM
        default "mips" if ARCH_MIPS
        default "x86" if ARCH_X86

# For compatibility with main Kiwi build system.
config BOOTARCH
	string
	default ARCH

config ARCH_CCFLAGS
        string
	default "-EL" if ARCH_MIPS && LITTLE_ENDIAN
	default "-EB" if ARCH_MIPS && BIG_ENDIAN
	default ""
```

## config/Kconfig.platform
```kconfig
#
# Copyright (C) 2011-2013 Alex Smith
#
# Permission to use, copy, modify, and/or distribute this software for any
# purpose with or without fee is hereby granted, provided that the above
# copyright notice and this permission notice appear in all copies.
#
# THE SOFTWARE IS PROVIDED "AS IS" AND THE AUTHOR DISCLAIMS ALL WARRANTIES
# WITH REGARD TO THIS SOFTWARE INCLUDING ALL IMPLIED WARRANTIES OF
# MERCHANTABILITY AND FITNESS. IN NO EVENT SHALL THE AUTHOR BE LIABLE FOR
# ANY SPECIAL, DIRECT, INDIRECT, OR CONSEQUENTIAL DAMAGES OR ANY DAMAGES
# WHATSOEVER RESULTING FROM LOSS OF USE, DATA OR PROFITS, WHETHER IN AN
# ACTION OF CONTRACT, NEGLIGENCE OR OTHER TORTIOUS ACTION, ARISING OUT OF
# OR IN CONNECTION WITH THE USE OR PERFORMANCE OF THIS SOFTWARE.
#

choice
	prompt "Platform"
	default PLATFORM_PC if ARCH_X86
	default PLATFORM_OMAP3 if ARCH_ARM
	default PLATFORM_MALTA if ARCH_MIPS

config PLATFORM_BCM2835
	bool "Raspberry Pi (Broadcom BCM2835)"
	depends on ARCH_ARM
	help
	  Target KBoot to run on the Raspberry Pi (Broadcom BCM2835 chipset).

config PLATFORM_MALTA
	bool "MIPS Malta"
	depends on ARCH_MIPS
	select LITTLE_ENDIAN
	help
	  Target the built system to the MIPS Malta evaluation board.

config PLATFORM_OMAP3
	bool "Texas Instruments OMAP3"
	depends on ARCH_ARM
	help
	  Target KBoot to run on Texas Instruments' OMAP3 platform. This
	  includes boards such as the BeagleBoard.

config PLATFORM_PC
	bool "Standard PC"
	depends on ARCH_X86
	help
	  Target KBoot to run on standard PCs (nearly all x86 computers).

endchoice

config PLATFORM
	string
	default "bcm2835" if PLATFORM_BCM2835
	default "malta" if PLATFORM_MALTA
	default "omap3" if PLATFORM_OMAP3
	default "pc" if PLATFORM_PC
```

## source/Kconfig
```kconfig
#
# Copyright (C) 2011-2012 Alex Smith
#
# Permission to use, copy, modify, and/or distribute this software for any
# purpose with or without fee is hereby granted, provided that the above
# copyright notice and this permission notice appear in all copies.
#
# THE SOFTWARE IS PROVIDED "AS IS" AND THE AUTHOR DISCLAIMS ALL WARRANTIES
# WITH REGARD TO THIS SOFTWARE INCLUDING ALL IMPLIED WARRANTIES OF
# MERCHANTABILITY AND FITNESS. IN NO EVENT SHALL THE AUTHOR BE LIABLE FOR
# ANY SPECIAL, DIRECT, INDIRECT, OR CONSEQUENTIAL DAMAGES OR ANY DAMAGES
# WHATSOEVER RESULTING FROM LOSS OF USE, DATA OR PROFITS, WHETHER IN AN
# ACTION OF CONTRACT, NEGLIGENCE OR OTHER TORTIOUS ACTION, ARISING OUT OF
# OR IN CONNECTION WITH THE USE OR PERFORMANCE OF THIS SOFTWARE.
#

config KBOOT_UI
	bool "Menu/configuration interface"
	default y
	depends on KBOOT_HAVE_UI
	help
	  Enable the user interface. If disabled, the menu interface is disabled
	  so configuration files will not support multiple entries. The system
	  must be loaded at the top level of the config file.

#########################
menu "Filesystem support"
	depends on KBOOT_HAVE_DISK
#########################

config KBOOT_FS_EXT2
	bool "Ext2/3/4 filesystem"
	default y
	help
	  Enable support for booting from Ext2/3/4 filesystems.

config KBOOT_FS_ISO9660
	bool "ISO9660 CDROM filesystem"
	default y
	help
	  Enable support for booting from ISO9660-formatted CDs.

config KBOOT_FS_ZLIB
	bool "File decompression support"
	default y
	help
	  Enable support for reading compressed files via zlib.

#######
endmenu
#######

############################
menu "Partition map support"
	depends on KBOOT_HAVE_DISK
############################

config KBOOT_PARTITION_MAP_MSDOS
	bool "MS-DOS (MBR) partition support"
	default y
	help
	  Enable support for MS-DOS/MBR partition tables. You probably want
	  this.

#######
endmenu
#######

###############################
menu "Operating system support"
###############################

config KBOOT_LOADER_KBOOT
	bool "KBoot kernel support"
	default y
	depends on KBOOT_HAVE_LOADER_KBOOT32 || KBOOT_HAVE_LOADER_KBOOT64
	help
	  Enable support for loading kernels using the KBoot boot format.

config KBOOT_LOADER_LINUX
	bool "Linux kernel support"
	default y
	depends on KBOOT_HAVE_LOADER_LINUX
	help
	  Enable support for loading Linux kernels.

#######
endmenu
#######

if ARCH_ARM
source "arch/arm/Kconfig"
endif
if ARCH_MIPS
source "arch/mips/Kconfig"
endif
if ARCH_X86
source "arch/x86/Kconfig"
endif

if PLATFORM_BCM2835
source "platform/bcm2835/Kconfig"
endif
if PLATFORM_MALTA
source "platform/malta/Kconfig"
endif
if PLATFORM_OMAP3
source "platform/omap3/Kconfig"
endif
if PLATFORM_PC
source "platform/pc/Kconfig"
endif
```
